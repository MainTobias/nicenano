## Kconfig.nicenano
```kconfig
# nRF52840 Dongle NRF52840 board configuration

# Copyright (c) 2018 Nordic Semiconductor ASA
# SPDX-License-Identifier: Apache-2.0

config BOARD_NICENANO
	bool "Enable support for Nice Nano board"
	select SOC_NRF52840_QIAA
```

## board.yml
```yaml
board:
  name: nicenano
  full_name: Nice Nano v2
  vendor: nordic
  socs:
  - name: nrf52840
```

## dts/bindings/ext-vcc.yaml
```yaml
# Copyright (c) 2023 Libre Solar Technologies GmbH
# SPDX-License-Identifier: Apache-2.0

description: GPIO pin to switch a ext vcc on or off

compatible: "ext-vcc"

properties:
  control-gpios:
    type: phandle-array
    required: true
    description: |
      The GPIO to control the external vcc.
```
